## Sources/Kconfig
```kconfig
# Copyright 2026 Filip Dymczyk and Konrad Grucel

rsource "drivers/Kconfig"
rsource "robot_control/Kconfig"
```

## Sources/drivers/Kconfig
```kconfig
# Copyright 2026 Filip Dymczyk and Konrad Grucel

rsource "logger/Kconfig"
rsource "utils/Kconfig"
rsource "battery_level/Kconfig"
rsource "motor_controller/Kconfig"
rsource "imu/Kconfig"
rsource "bluetooth/Kconfig"
rsource "interface/Kconfig"
rsource "model_identification/Kconfig"
rsource "encoder/Kconfig"
rsource "watchdog_controller/Kconfig"
rsource "dfu_smp/Kconfig"
```

## Sources/drivers/battery_level/Kconfig
```kconfig
# Copyright 2026 Filip Dymczyk and Konrad Grucel


config BATTERY_LEVEL_DRV
    bool "battery measurement module"
    select ADC

if BATTERY_LEVEL_DRV

config MAX_BATTERY_LEVEL
    int "battery max level [mV]"
    default 8400

config MIN_BATTERY_LEVEL
    int "battery max level [mV]"
    default 6000

config BATTERY_LEVEL_LOG
    bool "Enable logging from battery level driver"
    depends on LOGGER_DRV

endif #BATTERY_LEVEL_DRV
```

## Sources/drivers/bluetooth/Kconfig
```kconfig
config BLUETOOTH_DRV
    bool  "Enable BLE driver"
    select BT
    select BT_PERIPHERAL
    select BT_NUS
    select BT_GATT_CLIENT
    select BT_USER_PHY_UPDATE
    select BT_USER_DATA_LEN_UPDATE
```

## Sources/drivers/dfu_smp/Kconfig
```kconfig
config DFU_BLE
    bool "Enable DFU over BLE SMP"
    depends on BLUETOOTH_DRV

if DFU_BLE

rsource "Kconfig.dfu_smp.defconfig"

endif

module = DFU_BLE
module-str = DFU_BLE
moudle-dep = LOG
module-help = Enables DFU BLE logging over serial

source "${ZEPHYR_BASE}/subsys/logging/Kconfig.template.log_config"
```

## Sources/drivers/dfu_smp/Kconfig.dfu_smp.defconfig
```kconfig
# Copyright 2026 Filip Dymczyk and Konrad Grucel

config NET_BUF
    default y

config CRC
    default y

config BT_BONDABLE
    default n

config FLASH
    default y

config FLASH_MAP
    default y

config BOOTLOADER_MCUBOOT
    default y

config MCUMGR_GRP_OS_BOOTLOADER_INFO
    default y

config MCUMGR
    default y

config MCUMGR_TRANSPORT_BT
    default y

config IMG_MANAGER
    default y

config STREAM_FLASH
    default y

config ZCBOR
    default y

config MCUMGR_GRP_IMG
    default y

config MCUMGR_GRP_OS
    default y

config MCUMGR_GRP_IMG_STATUS_HOOKS
    default y

config IMG_ERASE_PROGRESSIVELY
    default y


choice MCUMGR_TRANSPORT_BT_PERM
    default MCUMGR_TRANSPORT_BT_PERM_RW
endchoice

config MCUMGR_TRANSPORT_NETBUF_COUNT
    default 6

config MCUMGR_MGMT_NOTIFICATION_HOOKS
    default y

config MCUMGR_GRP_IMG_UPLOAD_CHECK_HOOK
    default y

config MCUMGR_SMP_COMMAND_STATUS_HOOKS
    default y

config MCUMGR_TRANSPORT_NETBUF_SIZE
    default 2475

config SYSTEM_WORKQUEUE_STACK_SIZE
    default 2800

config BT_DRV_RX_STACK_SIZE
    default 1024

config BT_DRV_TX_STACK_SIZE
    default 1024

config BT_CENTRAL
    default n

config BT_PERIPHERAL
    default y

config MCUMGR_TRANSPORT_BT_REASSEMBLY
    default y

config BT_CTLR
    default y

config MCUMGR_TRANSPORT_BT_CONN_PARAM_CONTROL
    default y

config NCS_SAMPLE_MCUMGR_BT_OTA_DFU_SPEEDUP
    default y

config MCUMGR_GRP_OS_MCUMGR_PARAMS
	default y

config BT_BUF_ACL_TX_COUNT
    default 20

config BT_BUF_ACL_RX_COUNT
    default 20

#Kconfig to test:

#enable this
## CONFIG_BT_CTLR_TX_PWR_DYNAMIC_CONTROL
#CONFIG_BT_CTLR_HCI_NUM_CMD_PKT_MAX=1
#CONFIG_BT_CTLR_ADV_EXT_CODING_SELECTION_SUPPORT=y

#disable this
#CONFIG_BT_CTLR_ECDH_SUPPORT=y
#CONFIG_BT_CTLR_LE_ENC=y
#CONFIG_BT_CTLR_ECDH=y
```

## Sources/drivers/imu/Kconfig
```kconfig
config IMU_DRV
    bool "IMU driver module"
    select MPU6050
    select SENSOR
    select I2C
    select GPIO # To be checked if it's needed

if IMU_DRV

config IMU_LOG
    bool "Enable logging from IMU driver"
    depends on LOGGER_DRV

config IMU_CALIBRATE_GYRO
    bool "Calibrate IMU gyro before operation"
    select LOGGER_DRV
    select IMU_LOG

endif #IMU_DRV
```

## Sources/drivers/interface/Kconfig
```kconfig
config INTERFACE_DRV
    bool "led blinking module"

if INTERFACE_DRV

config INTERFACE_LOG
    bool "Enable logging from interface driver"
    depends on LOGGER_DRV

endif # INTERFACE_DRV
```

## Sources/drivers/logger/Kconfig
```kconfig
# Copyright 2026 Filip Dymczyk and Konrad Grucel

config LOGGER_DRV
    bool "BLE diagnostic logger module"
```

## Sources/drivers/model_identification/Kconfig
```kconfig
# Copyright 2026 Filip Dymczyk and Konrad Grucel

config MODEL_IDENTIFICATION_DRV
    bool "motor controller module"
```

## Sources/drivers/motor_controller/Kconfig
```kconfig
config MOTOR_CONTROLLER_DRV
    bool "motor controller module"
    select PWM

if MOTOR_CONTROLLER_DRV

config PWM_LIMIT
    int "Max PWM limit"
    default  100

config PWM_PERIOD_US
    int "PWM PERIOD [us]"
    default  100 # Equivalent of 0.1 ms.

config MOTOR_CONTROLLER_LOG
    bool "Enable logging from motors driver"
    depends on LOGGER_DRV

endif #MOTOR_CONTROLLER_DRV
```

## Sources/drivers/proximity_sensor/Kconfig
```kconfig
# Copyright 2026 Filip Dymczyk and Konrad Grucel

config PROXIMITY_SENSOR_DRV
    bool "Proximity sensor module"
    select GPIO
    
if PROXIMITY_SENSOR_DRV

config  PROXIMITY_SENSOR_LOG
    bool "Enable logs from proximity sensor module"
    depends on LOGGER_DRV

endif
```

## Sources/drivers/utils/Kconfig
```kconfig
# Copyright 2026 Filip Dymczyk and Konrad Grucel

config  UTILS_LOG
    bool "Enable logs from utils module"
    depends on LOGGER_DRV
```

## Sources/drivers/watchdog_controller/Kconfig
```kconfig
config WATCHDOG_CONTROLLER_DRV
    bool "Watchdog controller driver module"
    select WATCHDOG
    depends on !IMU_CALIBRATE_GYRO

if WATCHDOG_CONTROLLER_DRV

config WATCHDOG_CONTROLLER_DRV_LOG
    bool "Enable logging from watchdog controller driver module"
    depends on LOGGER_DRV

config WATCHDOG_MAX_TIMEOUT_MS
    int "Watchdog maximum timeout in milliseconds"
    default 200

endif #WATCHDOG_CONTROLLER_DRV
```

## Sources/robot_control/Kconfig
```kconfig
# Copyright 2026 Filip Dymczyk and Konrad Grucel

config ROBOT_CONTROL
    bool "Regulator driver module"
    depends on IMU_DRV

if ROBOT_CONTROL

config ROBOT_CONTROL_LOG
    bool "Enable logging from robot control loop"
    depends on LOGGER_DRV

config PID_ENABLED
    bool "PID controller enabled, else enable LQR"

config VALIDATE_ROBOT_ANGLE
    bool "Validate robot angle and disable motors if angle is out of range"

endif #ROBOT_CONTROL
```

## drivers/Kconfig
```kconfig
rsource "utils/Kconfig"
rsource "battery_level/Kconfig"
rsource "motor_controller/Kconfig"
rsource "imu/Kconfig"
rsource "logger/Kconfig"
rsource "interface/Kconfig"
rsource "model_identification/Kconfig"
rsource "encoder/Kconfig"
rsource "supervisor/Kconfig"
```

## drivers/battery_level/Kconfig
```kconfig
config BATTERY_LEVEL_DRV
    bool "battery measurement module"
    select ADC

if BATTERY_LEVEL_DRV

config MAX_BATTERY_LEVEL
    int "battery max level [mV]"
    default 8400

config MIN_BATTERY_LEVEL
    int "battery max level [mV]"
    default 6000

config BATTERY_LEVEL_LOG
    bool "Enable logging from battery level driver"

endif #BATTERY_LEVEL_DRV
```

## drivers/encoder/Kconfig
```kconfig
config ENCODER_DRV
    bool "Encoder measurement module"
    select GPIO
    
if ENCODER_DRV

config ENCODER_DATA_UPDATE_MS
    int "Encoder measurement interval in ms"
    default 100

config IMPULSE_TO_SHAFT_ROTATION
    int "Amount of encoder impulses when the motor shaft make a full rotation"
    default 800

config WHEEL_DIAMETER_MM
    int "Wheel diameter in mm"
    default 65
endif
```

## drivers/imu/Kconfig
```kconfig
config IMU_DRV
    bool "IMU driver module"
    select MPU6050
    select SENSOR
    select I2C
    select GPIO # To be checked if it's needed

if IMU_DRV

config IMU_LOG
    bool "Enable logging from IMU driver"
    depends on LOGGER_DRV

endif #IMU_DRV
```

## drivers/interface/Kconfig
```kconfig
config INTERFACE_DRV
    bool "led blinking module"

if INTERFACE_DRV

config INTERFACE_LOG
    bool "Enable logging from interface driver"

endif # INTERFACE_DRV
```

## drivers/logger/Kconfig
```kconfig
config LOGGER_DRV
    bool "BLE and serial logger module"
    select LOG

if LOGGER_DRV

config LOG_OVER_BLE
    bool  "enable seding logs over BLE"
    depends on LOGGER_DRV
    select BT
    select BT_PERIPHERAL
    select BT_NUS

config LOG_OVER_SERIAL
    depends on LOGGER_DRV
    bool "enable seding logs over serial"

module = LOGGER
module-str = LOGGER
source "${ZEPHYR_BASE}/subsys/logging/Kconfig.template.log_config"

endif #LOGGER_DRV
```

## drivers/model_identification/Kconfig
```kconfig
config MODEL_IDENTIFICATION_DRV
    bool "motor controller module"
    depends on LOG_OVER_SERIAL

if MODEL_IDENTIFICATION_DRV

config MODEL_IDENTIFICATION_LOG
    bool "Enable logging from model identification driver"
    depends on MODEL_IDENTIFICATION_DRV

endif #REGULATOR_DRV
```

## drivers/motor_controller/Kconfig
```kconfig
config MOTOR_CONTROLLER_DRV
    bool "motor controller module"
    select PWM

if MOTOR_CONTROLLER_DRV

config PWM_LIMIT
    int "Max PWM limit"
    default  100

config PWM_PERIOD_NS
    int "PWM PERIOD [ns]"
    default  20000000

config MOTOR_CONTROLLER_LOG
    bool "Enable logging from motors driver"
    depends on LOGGER_DRV

endif #MOTOR_CONTROLLER_DRV
```
