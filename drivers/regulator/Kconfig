## drivers/regulator/Kconfig
```kconfig
config REGULATOR_DRV
    bool "Regulator driver module"
    depends on IMU_DRV
    depends on MOTOR_CONTROLLER_DRV

if REGULATOR_DRV

config BALANCE_REGULATOR_SAMPLE_TIME
    int "Balance regulator sampling time in milliseconds"
    default 1

config ROTATION_REGULATOR_SAMPLE_TIME
    int "Balance regulator sampling time in milliseconds"
    default 10

config REGULATOR_LOG
    bool "Enable logging from motors driver"
    depends on LOGGER_DRV

config ALPHA
    int "Angle filter coefficient unscaled"
    default 10

config ALPHA_SCALER
    int "Alpha coefficient scaler"
    default 100

config PID_ENABLED
    bool "PID controller enabled, else enable LQR"

endif #REGULATOR_DRV
```

## drivers/supervisor/Kconfig
```kconfig
config SAFETY_ANGLE
    int "maxium tilt angle (in deegrees) before system off"
    default 35
```

## drivers/utils/Kconfig
```kconfig
config  UTILS_LOG
    bool "Enable logs from utils module"
    depends on LOGGER_DRV
```

## dts/bindings/encoder.yaml
```yaml
description: |
  Incremental encoder

compatible: "inc-enc"

properties:
  channel-a-gpios:
    type: phandle-array
    required: true
    description: GPIO specifier for encoder channel A

  channel-b-gpios:
    type: phandle-array
    required: true
    description: GPIO specifier for encoder channel B
```

## dts/bindings/pwm-dc.yaml
```yaml
description: PWM-driven DC motor.

compatible: "pwm-dc"

properties:
  pwms:
    required: true
    type: phandle-array
    description: PWM specifier driving the dc motor.
  
```

## robot_control/Kconfig
```kconfig
config ROBOT_CONTROL
    bool "Regulator driver module"
    depends on IMU_DRV
    depends on MOTOR_CONTROLLER_DRV

if ROBOT_CONTROL

config BALANCE_REGULATOR_SAMPLE_TIME
    int "Balance regulator sampling time in milliseconds"
    default 1

config ROTATION_REGULATOR_SAMPLE_TIME
    int "Rotation regulator sampling time in milliseconds"
    default 10

config ROBOT_CONTROL_LOG
    bool "Enable logging from robot control loop"
    depends on LOGGER_DRV

config PID_ENABLED
    bool "PID controller enabled, else enable LQR"

endif #ROBOT_CONTROL
```

## west.yml
```yaml
# Copyright 2026 Filip Dymczyk and Konrad Grucel

manifest:
  self:
    path: self-balancing-robot
  remotes:
    - name: nrf
      url-base: https://github.com/nrfconnect
  projects:
    - name: sdk-nrf
      remote: nrf
      path: nrf
      revision: v2.8.0
      import: true
      clone-depth: 1
```
